## conf/layer.conf
```bitbake
BBPATH =. "${LAYERDIR}:"

BBFILES += "${LAYERDIR}/recipes-*/*/*.bb \
            ${LAYERDIR}/recipes-*/*/*.bbappend"

BBFILE_COLLECTIONS += "meta-tpm2"
BBFILE_PATTERN_meta-tpm2 := "^${LAYERDIR}/"
BBFILE_PRIORITY_meta-tpm2 = "7"

# This should only be incremented on significant changes that will
# cause compatibility issues with other layers
LAYERVERSION_meta-tpm2 = "1"

LAYERDEPENDS_meta-tpm2 = "core"
```
